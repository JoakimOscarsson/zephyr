## CMakeLists.txt
```
cmake_minimum_required(VERSION 3.20.0)

set(ZEPHYR_EXTRA_MODULES "${CMAKE_SOURCE_DIR}/../../custom_modules/say_hello")

find_package(Zephyr REQUIRED HINTS $ENV{ZEPHYR_BASE})
project(hello)

target_sources(app PRIVATE src/main.c)
```

## prj.conf
```kconfig
CONFIG_QEMU_ICOUNT=n

# Basic console output
CONFIG_PRINTK=y

# (Optional but recommended) Zephyr logging
CONFIG_LOG=y
CONFIG_LOG_DEFAULT_LEVEL=3

#Threads
#CONFIG_THREAD_NAME=y

# custom module
#CONFIG_SAY_HELLO=y
```

## src/main.c
```c
#include <zephyr/kernel.h>

#ifdef CONFIG_SAY_HELLO
#include "say_hello.h"
#endif

//Settings
static const int32_t sleep_time_ms = 1000;

int main(void){
    while(1) {

        #ifdef CONFIG_SAY_HELLO
        say_hello();
        #endif
        k_sleep(K_MSEC(sleep_time_ms));
    }
    return 0;
}
```
